## vmbuild/fort-ext/Config.in
```kconfig
source "$BR2_EXTERNAL_FORT_PATH/package/fort-client/Config.in"
source "$BR2_EXTERNAL_FORT_PATH/package/python-ray/Config.in"
```

## vmbuild/fort-ext/configs/fort_defconfig
```kconfig
# Architecture
BR2_x86_64=y

# System
BR2_TARGET_GENERIC_HOSTNAME="fort"
BR2_TARGET_GENERIC_ISSUE="Fort"
BR2_PACKAGE_DHCP=y
BR2_PACKAGE_DHCP_CLIENT=y
BR2_INIT_SYSTEMD=y
BR2_SYSTEM_BIN_SH_BASH=y

# Filesystem
# BR2_TARGET_ROOTFS_TAR is not set
BR2_TARGET_ROOTFS_CPIO=y
BR2_TARGET_ROOTFS_CPIO_FULL=y
BR2_TARGET_ROOTFS_CPIO_GZIP=y
BR2_TARGET_ROOTFS_OVERLAY="overlay"

# Linux headers same as kernel
BR2_PACKAGE_HOST_LINUX_HEADERS_CUSTOM_6_12=y
BR2_TOOLCHAIN_HEADERS_LATEST=y
BR2_TOOLCHAIN_HEADERS_AT_LEAST="6.12"

# Rootfs overlay
BR2_ROOTFS_OVERLAY="$(BR2_EXTERNAL_FORT_PATH)/board/fort/rootfs-overlay"
BR2_ROOTFS_POST_BUILD_SCRIPT="$(BR2_EXTERNAL_FORT_PATH)/board/fort/post-build-ray-agents.sh"
BR2_ROOTFS_POST_IMAGE_SCRIPT="$(BR2_EXTERNAL_FORT_PATH)/board/fort/post-image.sh"

# Kernel
BR2_LINUX_KERNEL=y
BR2_LINUX_KERNEL_CUSTOM_GIT=y
BR2_LINUX_KERNEL_CUSTOM_REPO_URL="https://github.com/torvalds/linux.git"
BR2_LINUX_KERNEL_CUSTOM_REPO_VERSION="v6.12"
BR2_LINUX_KERNEL_VERSION="v6.12"
BR2_LINUX_KERNEL_PATCH="$(BR2_EXTERNAL_FORT_PATH)/board/fort/patches/linux"
BR2_LINUX_KERNEL_USE_CUSTOM_CONFIG=y
BR2_LINUX_KERNEL_CUSTOM_CONFIG_FILE="$(BR2_EXTERNAL_FORT_PATH)/board/fort/linux.config"
BR2_LINUX_KERNEL_NEEDS_HOST_LIBELF=y

# Python
BR2_PACKAGE_PYTHON3=y
BR2_PACKAGE_PYTHON_PIP=y
BR2_PACKAGE_BZIP2=y
BR2_PACKAGE_XZ=y
BR2_PACKAGE_ZIP=y
BR2_PACKAGE_PYTHON3_ZLIB=y
BR2_PACKAGE_PYTHON3_XZ=y
BR2_PACKAGE_PYTHON3_BZIP2=y
BR2_INSTALL_LIBSTDCPP=y
BR2_TOOLCHAIN_BUILDROOT_CXX=y
BR2_PACKAGE_HOST_GCC_TARGET=y
BR2_TOOLCHAIN_BUILDROOT_LIBSTDCPP=y
BR2_PACKAGE_GCC=y
BR2_PACKAGE_GCC_TARGET=y
BR2_PACKAGE_LIBSTDCPP=y
BR2_PACKAGE_FORT_CLIENT=y
BR2_PACKAGE_PYTHON_RAY=y
```

## vmbuild/fort-ext/package/fort-client/Config.in
```kconfig
config BR2_PACKAGE_FORT_CLIENT
	bool "fort-client"
	depends on BR2_PACKAGE_HOST_GO_TARGET_ARCH_SUPPORTS
	help
	  Fort ATLS client executable.
```

## vmbuild/fort-ext/package/python-ray/Config.in
```kconfig
config BR2_PACKAGE_PYTHON_RAY
	bool "python-ray"
	depends on BR2_PACKAGE_PYTHON3
	help
	  Pre-installs Ray, scipy and numpy wheels into the target rootfs
	  at build time so the CVM does not need to run pip at boot.
```
